## meta-fulan/conf/layer.conf
```bitbake
# We have a conf and classes directory, append to BBPATH
BBPATH .= ":${LAYERDIR}"

# We have a recipes directory, add to BBFILES
BBFILES += "${LAYERDIR}/recipes-*/*.bb ${LAYERDIR}/recipes-*/*.bbappend \
            ${LAYERDIR}/recipes-*/*/*.bb ${LAYERDIR}/recipes-*/*/*.bbappend \
            ${LAYERDIR}/recipes-*/*/*/*.bb ${LAYERDIR}/recipes-*/*/*/*.bbappend"

LAYERSERIES_COMPAT_meta-fulan-layer = "warrior"

# Additional license directories.
LICENSE_PATH += "${LAYERDIR}/conf/license"

META-fulan-BASE := '${@os.path.normpath("${LAYERDIR}/../")}'
META-fulan-BASE[vardepvalue] = 'meta-fulan'

WAF_CROSS_ANSWERS_PATH_sh4 = "${LAYERDIR}/files/waf-cross-answers"

DEBUG_PREFIX_MAP = "-fdebug-prefix-map=${WORKDIR}=/usr/src/debug/${PN}/${EXTENDPE}${PV}-${PR} \
                     -fdebug-prefix-map=${STAGING_DIR_HOST}= \
                     -fdebug-prefix-map=${STAGING_DIR_NATIVE}= \
"
DEBUG_FLAGS = "-g -feliminate-unused-debug-types ${DEBUG_PREFIX_MAP}"
```

## meta-fulan/conf/machine/spark7162.conf
```bitbake
require conf/machine/include/fulan-oem.inc

SOC_FAMILY = "sti7162"

MACHINE_ESSENTIAL_EXTRA_RDEPENDS += " \
    stlinux24-sh4-stmfb-firmware-stx7105 \
"

MACHINE_FEATURES += "spark7162"
```

## meta-openpli/conf/layer.conf
```bitbake
# We have a conf and classes directory, append to BBPATH
BBPATH .= ":${LAYERDIR}"

# We have a recipes directory, add to BBFILES
BBFILES += "${LAYERDIR}/recipes-*/*.bb ${LAYERDIR}/recipes-*/*.bbappend \
            ${LAYERDIR}/recipes-*/*/*.bb ${LAYERDIR}/recipes-*/*/*.bbappend \
            ${LAYERDIR}/recipes-*/*/*/*.bb ${LAYERDIR}/recipes-*/*/*/*.bbappend"

BBFILE_COLLECTIONS += "meta-openpli-layer"
BBFILE_PATTERN_meta-openpli-layer := "^${LAYERDIR}/"
BBFILE_PRIORITY_meta-openpli-layer = "7"

OPENPLI_BASE := '${@os.path.normpath("${LAYERDIR}/../")}'
# Prevent current directory creeping into sstate objects. Otherwise, building
# in another TOPDIR will cause recipes using this variable to be rebuilt.
OPENPLI_BASE[vardepvalue] = 'meta-openpli'

LICENSE_PATH += "${LAYERDIR}/licenses"

INSANE_SKIP_${PN} += "already-stripped"

#Include glib-gettextize, subversion and msgfmt(gettext) to hosttools
HOSTTOOLS += "svn zip unzip java sshpass curl whoami"

DEFAULT_TIMEZONE ?= "GMT"

LAYERSERIES_COMPAT_local-layer = "warrior zeus"
LAYERSERIES_COMPAT_meta-python = "warrior zeus"
LAYERSERIES_COMPAT_openembedded-layer = "warrior zeus"
LAYERSERIES_COMPAT_meta-openpli-layer = "warrior zeus"

# This prevents bitbake to fail at do_package caused by default OE-core split style variable setting
PACKAGE_DEBUG_SPLIT_STYLE = "debug-without-src"
```

## meta-xtrend/conf/layer.conf
```bitbake
# We have a conf and classes directory, append to BBPATH
BBPATH .= ":${LAYERDIR}"

BBFILES += "${LAYERDIR}/recipes-*/*/*.bb ${LAYERDIR}/recipes-*/*/*.bbappend"
LAYERSERIES_COMPAT_xtrend-layer = "dunfell"

METAXTREND_BASE := '${@os.path.normpath("${LAYERDIR}/../")}'
# Prevent current directory creeping into sstate objects. Otherwise, building
# in another TOPDIR will cause recipes using this variable to be rebuilt.
METAXTREND_BASE[vardepvalue] = 'meta-xtrend'
```
